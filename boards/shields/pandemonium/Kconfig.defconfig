## boards/shields/pandemonium/Kconfig.defconfig
```kconfig
# Copyright (c) 2020 The ZMK Contributors
# SPDX-License-Identifier: MIT

if SHIELD_PANDEMONIUM

config ZMK_KEYBOARD_NAME
    default "PANDEMONIUM"

endif
```
